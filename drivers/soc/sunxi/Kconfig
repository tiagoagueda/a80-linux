## drivers/soc/sunxi/Kconfig
```kconfig
# SPDX-License-Identifier: GPL-2.0-only
#
# Allwinner sunXi SoC drivers
#

config SUNXI_MBUS
	bool
	default ARCH_SUNXI
	depends on ARM || ARM64
	help
	  Say y to enable the fixups needed to support the Allwinner
	  MBUS DMA quirks.

config SUNXI_SRAM
	bool
	default ARCH_SUNXI
	select REGMAP_MMIO
	help
	  Say y here to enable the SRAM controller support. This
	  device is responsible on mapping the SRAM in the sunXi SoCs
	  whether to the CPU/DMA, or to the devices.

config SUNXI_ARISC
	tristate "Allwinner A80 AR100 coprocessor driver"
	depends on ARCH_SUNXI || COMPILE_TEST
	depends on HAS_IOMEM
	help
	  Say y here to enable the driver for the AR100 power-management
	  coprocessor found on the Allwinner A80. It is required to power
	  up the Cortex-A15 cluster and to change CPU frequency, both of
	  which the SoC delegates to this coprocessor.
```
